## zephyrproject/veed/build/Kconfig/arch/Kconfig
```kconfig
# Load Zephyr Arch Kconfig descriptions.
osource "/home/simonas/zephyrproject/zephyr/arch/rx/Kconfig"
osource "/home/simonas/zephyrproject/zephyr/arch/x86/Kconfig"
osource "/home/simonas/zephyrproject/zephyr/arch/xtensa/Kconfig"
osource "/home/simonas/zephyrproject/zephyr/arch/sparc/Kconfig"
osource "/home/simonas/zephyrproject/zephyr/arch/riscv/Kconfig"
osource "/home/simonas/zephyrproject/zephyr/arch/posix/Kconfig"
osource "/home/simonas/zephyrproject/zephyr/arch/mips/Kconfig"
osource "/home/simonas/zephyrproject/zephyr/arch/arm64/Kconfig"
osource "/home/simonas/zephyrproject/zephyr/arch/arm/Kconfig"
osource "/home/simonas/zephyrproject/zephyr/arch/arc/Kconfig"
```

## zephyrproject/veed/build/Kconfig/boards/Kconfig.defconfig
```kconfig
# Load Zephyr board defconfig descriptions.
osource "/home/simonas/zephyrproject/zephyr/boards/st/stm32f746g_disco/Kconfig.defconfig"
```

## zephyrproject/veed/build/Kconfig/boards/Kconfig.sysbuild
```kconfig
# Load Sysbuild board Kconfig descriptions.
osource "/home/simonas/zephyrproject/zephyr/boards/st/stm32f746g_disco/Kconfig.sysbuild"
```

## zephyrproject/veed/build/Kconfig/soc/Kconfig
```kconfig
# Load Zephyr SoC Kconfig descriptions.
osource "/home/simonas/zephyrproject/zephyr/soc/xlnx/zynqmp/Kconfig"
osource "/home/simonas/zephyrproject/zephyr/soc/xlnx/zynq7000/Kconfig"
osource "/home/simonas/zephyrproject/zephyr/soc/xlnx/versalnet/Kconfig"
osource "/home/simonas/zephyrproject/zephyr/soc/xlnx/versal2/Kconfig"
osource "/home/simonas/zephyrproject/zephyr/soc/xen/Kconfig"
osource "/home/simonas/zephyrproject/zephyr/soc/wch/ch32v/Kconfig"
osource "/home/simonas/zephyrproject/zephyr/soc/ti/simplelink/Kconfig"
osource "/home/simonas/zephyrproject/zephyr/soc/ti/mspm0/Kconfig"
osource "/home/simonas/zephyrproject/zephyr/soc/ti/lm3s6965/Kconfig"
osource "/home/simonas/zephyrproject/zephyr/soc/ti/k3/Kconfig"
osource "/home/simonas/zephyrproject/zephyr/soc/telink/tlsr/Kconfig"
osource "/home/simonas/zephyrproject/zephyr/soc/starfive/jh71xx/Kconfig"
osource "/home/simonas/zephyrproject/zephyr/soc/st/stm32/Kconfig"
osource "/home/simonas/zephyrproject/zephyr/soc/snps/qemu_arc/Kconfig"
osource "/home/simonas/zephyrproject/zephyr/soc/snps/nsim/arc_v/Kconfig"
osource "/home/simonas/zephyrproject/zephyr/soc/snps/nsim/arc_classic/Kconfig"
osource "/home/simonas/zephyrproject/zephyr/soc/snps/hsdk4xd/Kconfig"
osource "/home/simonas/zephyrproject/zephyr/soc/snps/hsdk/Kconfig"
osource "/home/simonas/zephyrproject/zephyr/soc/snps/emsk/Kconfig"
osource "/home/simonas/zephyrproject/zephyr/soc/snps/emsdp/Kconfig"
osource "/home/simonas/zephyrproject/zephyr/soc/snps/arc_iot/Kconfig"
osource "/home/simonas/zephyrproject/zephyr/soc/silabs/Kconfig"
osource "/home/simonas/zephyrproject/zephyr/soc/sifive/sifive_freedom/Kconfig"
osource "/home/simonas/zephyrproject/zephyr/soc/sensry/Kconfig"
osource "/home/simonas/zephyrproject/zephyr/soc/rockchip/Kconfig"
osource "/home/simonas/zephyrproject/zephyr/soc/renode/riscv_virtual/Kconfig"
osource "/home/simonas/zephyrproject/zephyr/soc/renode/cortex_r8_virtual/Kconfig"
osource "/home/simonas/zephyrproject/zephyr/soc/renesas/smartbond/Kconfig"
osource "/home/simonas/zephyrproject/zephyr/soc/renesas/rz/Kconfig"
osource "/home/simonas/zephyrproject/zephyr/soc/renesas/rx/Kconfig"
osource "/home/simonas/zephyrproject/zephyr/soc/renesas/rcar/Kconfig"
osource "/home/simonas/zephyrproject/zephyr/soc/renesas/ra/Kconfig"
osource "/home/simonas/zephyrproject/zephyr/soc/realtek/ec/Kconfig"
osource "/home/simonas/zephyrproject/zephyr/soc/raspberrypi/rpi_pico/Kconfig"
osource "/home/simonas/zephyrproject/zephyr/soc/quicklogic/eos_s3/Kconfig"
osource "/home/simonas/zephyrproject/zephyr/soc/qemu/virt_riscv/Kconfig"
osource "/home/simonas/zephyrproject/zephyr/soc/qemu/malta/Kconfig"
osource "/home/simonas/zephyrproject/zephyr/soc/openisa/rv32m1/Kconfig"
osource "/home/simonas/zephyrproject/zephyr/soc/openhwgroup/cva6/Kconfig"
osource "/home/simonas/zephyrproject/zephyr/soc/oct/osd32mp15x/Kconfig"
osource "/home/simonas/zephyrproject/zephyr/soc/nxp/s32/Kconfig"
osource "/home/simonas/zephyrproject/zephyr/soc/nxp/rw/Kconfig"
osource "/home/simonas/zephyrproject/zephyr/soc/nxp/mcx/Kconfig"
osource "/home/simonas/zephyrproject/zephyr/soc/nxp/lpc/Kconfig"
osource "/home/simonas/zephyrproject/zephyr/soc/nxp/layerscape/Kconfig"
osource "/home/simonas/zephyrproject/zephyr/soc/nxp/kinetis/Kconfig"
osource "/home/simonas/zephyrproject/zephyr/soc/nxp/imxrt/Kconfig"
osource "/home/simonas/zephyrproject/zephyr/soc/nxp/imx/Kconfig"
osource "/home/simonas/zephyrproject/zephyr/soc/nuvoton/numicro/Kconfig"
osource "/home/simonas/zephyrproject/zephyr/soc/nuvoton/numaker/Kconfig"
osource "/home/simonas/zephyrproject/zephyr/soc/nuvoton/npcx/Kconfig"
osource "/home/simonas/zephyrproject/zephyr/soc/nuvoton/npcm/Kconfig"
osource "/home/simonas/zephyrproject/zephyr/soc/nordic/Kconfig"
osource "/home/simonas/zephyrproject/zephyr/soc/neorv32/Kconfig"
osource "/home/simonas/zephyrproject/zephyr/soc/native/inf_clock/Kconfig"
osource "/home/simonas/zephyrproject/zephyr/soc/microchip/sam/Kconfig"
osource "/home/simonas/zephyrproject/zephyr/soc/microchip/miv/Kconfig"
osource "/home/simonas/zephyrproject/zephyr/soc/microchip/mec/Kconfig"
osource "/home/simonas/zephyrproject/zephyr/soc/mediatek/mt8xxx/Kconfig"
osource "/home/simonas/zephyrproject/zephyr/soc/lowrisc/opentitan/Kconfig"
osource "/home/simonas/zephyrproject/zephyr/soc/litex/litex_vexriscv/Kconfig"
osource "/home/simonas/zephyrproject/zephyr/soc/ite/ec/Kconfig"
osource "/home/simonas/zephyrproject/zephyr/soc/intel/raptor_lake/Kconfig"
osource "/home/simonas/zephyrproject/zephyr/soc/intel/lakemont/Kconfig"
osource "/home/simonas/zephyrproject/zephyr/soc/intel/intel_socfpga_std/Kconfig"
osource "/home/simonas/zephyrproject/zephyr/soc/intel/intel_socfpga/Kconfig"
osource "/home/simonas/zephyrproject/zephyr/soc/intel/intel_niosv/Kconfig"
osource "/home/simonas/zephyrproject/zephyr/soc/intel/intel_ish/Kconfig"
osource "/home/simonas/zephyrproject/zephyr/soc/intel/intel_adsp/Kconfig"
osource "/home/simonas/zephyrproject/zephyr/soc/intel/elkhart_lake/Kconfig"
osource "/home/simonas/zephyrproject/zephyr/soc/intel/atom/Kconfig"
osource "/home/simonas/zephyrproject/zephyr/soc/intel/apollo_lake/Kconfig"
osource "/home/simonas/zephyrproject/zephyr/soc/intel/alder_lake/Kconfig"
osource "/home/simonas/zephyrproject/zephyr/soc/infineon/cat3/Kconfig"
osource "/home/simonas/zephyrproject/zephyr/soc/infineon/cat1c/Kconfig"
osource "/home/simonas/zephyrproject/zephyr/soc/infineon/cat1b/Kconfig"
osource "/home/simonas/zephyrproject/zephyr/soc/infineon/cat1a/Kconfig"
osource "/home/simonas/zephyrproject/zephyr/soc/gd/gd32/Kconfig"
osource "/home/simonas/zephyrproject/zephyr/soc/gaisler/leon3/Kconfig"
osource "/home/simonas/zephyrproject/zephyr/soc/gaisler/gr716a/Kconfig"
osource "/home/simonas/zephyrproject/zephyr/soc/espressif/Kconfig"
osource "/home/simonas/zephyrproject/zephyr/soc/ene/kb1200/Kconfig"
osource "/home/simonas/zephyrproject/zephyr/soc/efinix/sapphire/Kconfig"
osource "/home/simonas/zephyrproject/zephyr/soc/cdns/xtensa_sample_controller/Kconfig"
osource "/home/simonas/zephyrproject/zephyr/soc/cdns/sample_controller32/Kconfig"
osource "/home/simonas/zephyrproject/zephyr/soc/cdns/dc233c/Kconfig"
osource "/home/simonas/zephyrproject/zephyr/soc/brcm/bcmvk/Kconfig"
osource "/home/simonas/zephyrproject/zephyr/soc/brcm/bcm2712/Kconfig"
osource "/home/simonas/zephyrproject/zephyr/soc/brcm/bcm2711/Kconfig"
osource "/home/simonas/zephyrproject/zephyr/soc/bflb/Kconfig"
osource "/home/simonas/zephyrproject/zephyr/soc/atmel/sam0/Kconfig"
osource "/home/simonas/zephyrproject/zephyr/soc/atmel/sam/Kconfig"
osource "/home/simonas/zephyrproject/zephyr/soc/aspeed/Kconfig"
osource "/home/simonas/zephyrproject/zephyr/soc/arm/Kconfig"
osource "/home/simonas/zephyrproject/zephyr/soc/arm/beetle/Kconfig"
osource "/home/simonas/zephyrproject/zephyr/soc/antmicro/myra/Kconfig"
osource "/home/simonas/zephyrproject/zephyr/soc/andestech/Kconfig"
osource "/home/simonas/zephyrproject/zephyr/soc/amd/acp_6_0/Kconfig"
osource "/home/simonas/zephyrproject/zephyr/soc/ambiq/Kconfig"
osource "/home/simonas/zephyrproject/zephyr/soc/aesc/Kconfig"
osource "/home/simonas/zephyrproject/zephyr/soc/adi/max32/Kconfig"
```
